## conf/layer.conf
```bitbake
# We have a conf and classes directory, append to BBPATH
BBPATH .= ":${LAYERDIR}"

# We have a recipes directory, add to BBFILES
BBFILES += "${LAYERDIR}/recipes*/*/*.bb ${LAYERDIR}/recipes*/*/*.bbappend"

BBFILE_COLLECTIONS += "sunxi-extras"
BBFILE_PATTERN_sunxi-extras := "^${LAYERDIR}/"
BBFILE_PRIORITY_sunxi-extras = "10"

# This should only be incremented on significant changes that will
# cause compatibility issues with other layers
LAYERVERSION_sunxi-extras = "1"

LAYERDEPENDS_sunxi-extras = "meta-sunxi"

LAYERSERIES_COMPAT_sunxi-extras = "mickledore"
```

## conf/machine/pine64-pinephone-braveheart.conf
```bitbake
#@TYPE: Machine
#@NAME: pine64-pinephone-braveheart
#@DESCRIPTION: Machine configuration for the pinephone-braveheart, based on Allwinner A64 CPU

require conf/machine/include/sun50i.inc

KERNEL_DEVICETREE = "allwinner/sun50i-a64-pinephone-1.1.dtb"
UBOOT_MACHINE = "pinephone_defconfig"
SERIAL_CONSOLES ?= "115200;ttyS0"
SERIAL_CONSOLES_CHECK = "${SERIAL_CONSOLES}"
```
